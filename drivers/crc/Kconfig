## drivers/crc/Kconfig
```kconfig
# Copyright (c) 2024 Brill Power Ltd.
# SPDX-License-Identifier: Apache-2.0

menuconfig CRC_HW
	bool "CRC HW acceleration"

if CRC_HW

module = CRC_HW
module-str = CRC_HW
source "subsys/logging/Kconfig.template.log_config"

config CRC_INIT_PRIORITY
	int "CRC init priority"
	default KERNEL_INIT_PRIORITY_DEVICE
	depends on CRC_HW
	help
	  CRC driver device initialization priority.

config CRC_THREADSAFE
	bool "Make HW CRC threadsafe"
	default n
	depends on CRC_HW
	help
	  If hardware CRC driver is called from multiple threads, enabling
	  this option provides a mutex to guard against re-entrance

config CRC_STM32
	bool "STM32 CRC driver"
	default n
	depends on DT_HAS_ST_STM32_CRC_ENABLED && CRC_HW
	select USE_STM32_LL_CRC
	help
	  Enable the driver implementation for STM32 microcontrollers

endif # CRC
```

## drivers/display/Kconfig.ssd1327
```kconfig
# SSD1327 display controller configuration options

# Copyright (c) 2024 Savoir-faire Linux
# SPDX-License-Identifier: Apache-2.0

menuconfig SSD1327
	bool "SSD1327 display driver"
	default y
	depends on DT_HAS_SOLOMON_SSD1327FB_ENABLED
	select SPI if $(dt_compat_on_bus,$(DT_COMPAT_SOLOMON_SSD1327FB),spi)
	help
	  Enable driver for SSD1327 display.

if SSD1327

config SSD1327_DEFAULT_CONTRAST
	int "SSD1327 default contrast"
	default 128
	range 0 255
	help
	  SSD1327 default contrast.

endif # SSD1327
```

## dts/bindings/display/solomon,ssd1327fb-common.yaml
```yaml
# Copyright (c) 2024, Savoir-faire Linux
# SPDX-License-Identifier: Apache-2.0

include: display-controller.yaml

properties:
  oscillator_freq:
    type: int
    default: 0x00
    description: set front clock divider / oscillator frequency

  display-offset:
    type: int
    default: 0x00
    description: set vertical offset by com from 0 ~ 127

  start-line:
    type: int
    default: 0x00
    description: set start line

  multiplex-ratio:
    type: int
    required: true
    description: set multiplex ratio

  prechargep:
    type: int
    default: 0x0f
    description: set pre-charge period

  remap-value:
    type: int
    default: 0x51
    description: value to set the remap register

  reset-gpios:
    type: phandle-array
    description: RESET pin.

      The RESET pin of SSD1327 is active low.
      If connected directly the MCU pin should be configured
      as active low.

  inversion-on:
    type: boolean
    description: Turn on display color inverting
```

## dts/bindings/display/solomon,ssd1327fb-spi.yaml
```yaml
# Copyright (c) 2024, Savoir-faire Linux
# SPDX-License-Identifier: Apache-2.0

description: SSD1327 128x128 dot-matrix display controller on SPI bus

compatible: "solomon,ssd1327fb"

include: ["solomon,ssd1327fb-common.yaml", "spi-device.yaml"]

properties:
  data_cmd-gpios:
    type: phandle-array
    required: true
    description: D/C# pin.
```

## samples/boards/sensortile_box_pro/ble-fw-upgrade/sample.yaml
```yaml
sample:
  description: SensorTile.box Pro board ble firmware upgrade
  name: SensorTile.box Pro fw upgrade
tests:
  sample.board.sensortile_box_pro.ble-fw-upgrade:
    harness: bluetooth
    platform_allow: sensortile_box_pro
    tags: bluetooth
    depends_on:
      - gpio
      - uart
    # This test cannot be run in CI as it requires the presence of a
    # f/w blob that is not fetched by CI iself, as mentioned in
    # https://docs.zephyrproject.org/latest/contribute/bin_blobs.html#support-and-maintenance
    skip: true
```
